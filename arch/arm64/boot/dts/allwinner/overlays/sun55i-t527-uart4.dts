/dts-v1/;
/plugin/;
/ {
	fragment@0 {
		target = <&pio>;
		__overlay__ {
			uart4_pins_default: uart4_pins@0 {
				pins = "PI0", "PI1";
				function = "uart4";
			};
		};
	};
	
	fragment@1 {
		target = <&uart4>;
		__overlay__ {
			pinctrl-names = "default";
			pinctrl-0 = <&uart4_pins_default>;
			status = "okay";
		};
	};
	
};

