/dts-v1/;
/plugin/;
#include <dt-bindings/gpio/gpio.h>
#include <dt-bindings/gpio/sun4i-gpio.h>
#include <dt-bindings/leds/common.h>
/ {
	fragment@0 {
		target = <&pio>;
		__overlay__ {
			twi1_pins_PB_default: twi1@0 {
				pins = "PB4", "PB5";
				function = "twi1";
				drive-strength = <10>;
				bias-pull-up;
			};
		};
	};
	
	fragment@1 {
		target = <&twi1>;
		__overlay__ {
			clock-frequency = <400000>;
			pinctrl-0 = <&twi1_pins_PB_default>;
			pinctrl-names = "default";
			/* For stability and backwards compatibility, we recommend setting ‘twi_drv_used’ to 1 */
			twi_drv_used = <1>;
			status = "okay";
		};
	};
	
};

