/dts-v1/;
/plugin/;

#include <dt-bindings/gpio/gpio.h>
#include <dt-bindings/gpio/sun4i-gpio.h>
#include <dt-bindings/leds/common.h>
/ {
	fragment@0 {
		target = <&combophy>;
		__overlay__ {
			phy_use_sel = <1>; /* 0:PCIE; 1:USB3 */
			status = "okay";
		};
	};
	fragment@1 {
		target = <&usbc2>;
		__overlay__ {
			device_type = "usbc2";
			status = "okay";
		};
	};
	fragment@2 {
		target = <&xhci2>;
		__overlay__ {
			dr_mode = "host";
			status = "okay";
		};
	};
	fragment@3 {
		target = <&u2phy>;
		__overlay__ {
			status = "okay";
		};
	};
	
};




// &u2phy {
// 	status = "okay";
// };
