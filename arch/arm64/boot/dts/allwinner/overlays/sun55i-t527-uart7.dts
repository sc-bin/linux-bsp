/dts-v1/;
/plugin/;

/ {
	fragment@0 {
		target = <&pio>;
		__overlay__ {
			uart7_pins_default: uart7_pins@0 {
				pins = "PB13", "PB14";
				function = "uart7";
			};
		};
	};
	
	fragment@1 {
		target = <&uart7>;
		__overlay__ {
			pinctrl-names = "default";
			pinctrl-0 = <&uart7_pins_default>;
			status = "okay";
		};
	};
	
};

